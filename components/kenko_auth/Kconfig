## components/kenko_auth/Kconfig
```kconfig
menu "Kenko auth"

    config KENKO_AUTH_PASSWORD_MIN_LEN
        int "Minimum access password length"
        range 6 32
        default 8

    config KENKO_AUTH_PBKDF2_ITERATIONS
        int "PBKDF2 iterations"
        range 1000 200000
        default 5000
        help
            越大越难被离线爆破，代价是每次登录都要算这么多轮。

            ESP32-S3 实测约 147us/轮（硬件 SHA 已启用，瓶颈在 PSA 每轮的接口
            开销而非哈希本身）：5000 轮约 0.75 秒，20000 轮约 3 秒。

            设备的 HTTP 服务是单任务顺序处理的，登录期间所有请求都会被堵住，
            所以这个值直接决定了"登录时设备卡多久"。

            需要说明的是，这里的轮数在多大范围内都挡不住 GPU 爆破一个弱口令，
            真正起作用的是口令强度本身；轮数保护的主要是口令被复用到别处的场景。
            改动只影响之后新设的口令，已存的记录会沿用它自己保存的轮数。

    config KENKO_AUTH_MAX_SESSIONS
        int "Maximum concurrent sessions"
        range 1 16
        default 4

    config KENKO_AUTH_SESSION_TTL_HOURS
        int "Session lifetime (hours)"
        default 168

    config KENKO_AUTH_LOCKOUT_STEP_MS
        int "Login lockout step per failed attempt (ms)"
        default 500
        help
            连续失败会按次数线性拉长锁定时间，用来拖垮在线爆破。

    config KENKO_AUTH_LOCKOUT_MAX_MS
        int "Maximum login lockout (ms)"
        default 30000

    config KENKO_AUTH_FILE_NAME
        string "Credential file name"
        default "auth.json"

endmenu
```

## components/kenko_board/Kconfig
```kconfig
menu "Kenko board"

    config KENKO_DEVICE_PREFIX
        string "Device name prefix"
        default "kenko32"
        help
            出厂默认设备名与 mDNS 主机名的前缀，最终形式为 <prefix>-<mac 后四位>。

    menu "Status LED"

        config KENKO_WS2812_GPIO
            int "WS2812 data GPIO"
            range 0 48
            default 48
            help
                板载 WS2812B 的数据脚。源地 YD-ESP32-S3 上是 GPIO 47 或 48。

        config KENKO_LED_DEFAULT_BRIGHTNESS
            int "Default brightness (%)"
            range 0 100
            default 100

        config KENKO_LED_TASK_STACK
            int "LED task stack size"
            default 3072

        config KENKO_LED_TASK_PRIORITY
            int "LED task priority"
            default 4

    endmenu

    menu "BOOT button"

        config KENKO_BUTTON_GPIO
            int "Button GPIO"
            range 0 48
            default 0
            help
                默认上拉、按下接地。ESP32-S3 上 GPIO 0 同时是下载模式的 strapping 脚。

        config KENKO_BUTTON_POLL_INTERVAL_MS
            int "Poll interval (ms)"
            default 50

        config KENKO_BUTTON_PROVISIONING_MS
            int "Long press to enter provisioning (ms)"
            default 5000

        config KENKO_BUTTON_FACTORY_RESET_MS
            int "Long press to factory reset (ms)"
            default 10000

        config KENKO_BUTTON_TASK_STACK
            int "Button task stack size"
            default 3072

        config KENKO_BUTTON_TASK_PRIORITY
            int "Button task priority"
            default 5

    endmenu

endmenu
```

## components/kenko_settings/Kconfig
```kconfig
menu "Kenko settings"

    config KENKO_DEFAULT_TIMEZONE
        string "Default POSIX timezone"
        default "CST-8"
        help
            POSIX TZ 串。中国标准时间是 CST-8，UTC 是 UTC0。

    config KENKO_SETTINGS_DEFAULT_BRIGHTNESS
        int "Default status LED brightness (%)"
        range 0 100
        default 100

    config KENKO_SETTINGS_FILE_NAME
        string "Settings file name"
        default "settings.json"
        help
            相对于配置分区挂载点的文件名。

endmenu
```

## components/kenko_storage/Kconfig
```kconfig
menu "Kenko storage"

    config KENKO_STORAGE_PARTITION
        string "Config partition label"
        default "storage"
        help
            存放 WiFi 凭据与设备设置的 LittleFS 分区。挂载失败时会被自动格式化。

    config KENKO_STORAGE_BASE_PATH
        string "Config partition mount point"
        default "/storage"

    config KENKO_WEB_PARTITION
        string "Web asset partition label"
        default "web"
        help
            存放前端构建产物的 LittleFS 分区。挂载失败时不会格式化，
            以免把页面抹掉；Web 服务会退化为内置兜底页。

    config KENKO_WEB_BASE_PATH
        string "Web asset partition mount point"
        default "/web"

    config KENKO_JSON_FILE_MAX_BYTES
        int "Maximum size of a JSON config file"
        default 8192
        help
            超过这个大小的配置文件会被拒绝解析，防止损坏的文件把堆吃光。

endmenu
```

## components/kenko_time/Kconfig
```kconfig
menu "Kenko time"

    config KENKO_SNTP_SERVER_PRIMARY
        string "Primary NTP server"
        default "ntp.aliyun.com"

    config KENKO_SNTP_SERVER_SECONDARY
        string "Secondary NTP server"
        default "pool.ntp.org"

endmenu
```

## components/kenko_web/Kconfig
```kconfig
menu "Kenko web server"

    config KENKO_HTTP_PORT
        int "HTTP port"
        default 80

    config KENKO_HTTPD_TASK_STACK
        int "HTTP server task stack size"
        default 8192
        help
            静态资源处理里有若干 KB 的栈上缓冲（路径消毒、文件分块），留足余量。

    config KENKO_HTTPD_MAX_SOCKETS
        int "Maximum open sockets"
        range 1 13
        default 7

    config KENKO_API_BODY_MAX_BYTES
        int "Maximum JSON request body"
        default 4096

    config KENKO_OTA_CHUNK_BYTES
        int "OTA receive chunk size"
        default 2048

endmenu
```

## components/kenko_wifi/Kconfig
```kconfig
menu "Kenko WiFi"

    menu "Provisioning SoftAP"

        config KENKO_AP_IP
            string "SoftAP IPv4 address"
            default "192.168.6.1"
            help
                配网热点的固定地址，同时作为网关与 captive portal 的 DNS 应答。

        config KENKO_AP_NETMASK
            string "SoftAP netmask"
            default "255.255.255.0"

        config KENKO_AP_CHANNEL
            int "SoftAP channel"
            range 1 13
            default 1

        config KENKO_AP_MAX_CONNECTION
            int "SoftAP max clients"
            range 1 10
            default 4

        config KENKO_DNS_PORT
            int "Captive portal DNS port"
            default 53

        config KENKO_DNS_TTL_SECONDS
            int "Captive portal DNS answer TTL"
            default 60

        config KENKO_DNS_TASK_STACK
            int "DNS task stack size"
            default 4096

        config KENKO_DNS_TASK_PRIORITY
            int "DNS task priority"
            default 4

    endmenu

    menu "Station"

        config KENKO_WIFI_MAX_SAVED_NETWORKS
            int "Maximum saved networks"
            range 1 32
            default 16

        config KENKO_WIFI_CONFIG_FILE_NAME
            string "Saved networks file name"
            default "wifi_config.json"

        config KENKO_WIFI_CONNECT_TIMEOUT_MS
            int "Per-attempt connect timeout (ms)"
            default 15000

        config KENKO_WIFI_RETRY_BACKOFF_MS
            int "Backoff after a full round of failures (ms)"
            default 10000

        config KENKO_WIFI_SCAN_CACHE_TTL_MS
            int "Scan result cache TTL (ms)"
            default 15000
            help
                扫描会短暂打断连接，缓存可以避免页面反复刷新时反复扫描。

        config KENKO_WIFI_SCAN_MAX_RESULTS
            int "Maximum scan results kept"
            range 4 64
            default 32

        config KENKO_WIFI_TASK_STACK
            int "Connect loop task stack size"
            default 4096

        config KENKO_WIFI_TASK_PRIORITY
            int "Connect loop task priority"
            default 5

        choice KENKO_WIFI_POWER_SAVE
            prompt "Station power save mode"
            default KENKO_WIFI_PS_MIN_MODEM
            help
                默认的 MIN_MODEM 会带来最多一个 DTIM 周期的延迟抖动。
                做低延迟控制时选 NONE，电池供电时选 MAX_MODEM。

            config KENKO_WIFI_PS_NONE
                bool "None (lowest latency)"

            config KENKO_WIFI_PS_MIN_MODEM
                bool "Minimum modem"

            config KENKO_WIFI_PS_MAX_MODEM
                bool "Maximum modem (lowest power)"
        endchoice

    endmenu

endmenu
```

## main/Kconfig.projbuild
```kconfig
menu "Kenko application"

    config KENKO_STATE_TASK_STACK
        int "State machine task stack size"
        default 4096

    config KENKO_STATE_TASK_PRIORITY
        int "State machine task priority"
        default 6

    config KENKO_REBOOT_GRACE_MS
        int "Delay before restarting (ms)"
        default 800
        help
            留给 HTTP 响应发完的时间，否则前端只会看到连接被重置。

endmenu
```

## sdkconfig.defaults
```kconfig
# 本项目的构建配置真源。sdkconfig 是构建产物，不纳入版本控制。
# 修改后需要删除 build/ 或执行 `idf.py fullclean` 再构建。

CONFIG_IDF_TARGET="esp32s3"

# ---- Flash ----
# 板载 16MB Flash。保持 DIO：S3 模组上 QIO 的收益有限，而个别 flash 颗粒在
# 80MHz QIO 下并不稳定，出问题只能重新烧录。
CONFIG_ESPTOOLPY_FLASHSIZE_16MB=y
CONFIG_ESPTOOLPY_FLASHMODE_DIO=y
CONFIG_ESPTOOLPY_FLASHFREQ_80M=y

# ---- 分区表 ----
CONFIG_PARTITION_TABLE_CUSTOM=y
CONFIG_PARTITION_TABLE_CUSTOM_FILENAME="partitions.csv"
CONFIG_PARTITION_TABLE_OFFSET=0x8000

# ---- PSRAM ----
# ESP32-S3-WROOM-1-N16R8：8MB Octal PSRAM。不开启的话这 8MB 完全是浪费。
CONFIG_SPIRAM=y
CONFIG_SPIRAM_MODE_OCT=y
CONFIG_SPIRAM_SPEED_80M=y
CONFIG_SPIRAM_USE_MALLOC=y
# 大块分配优先走 PSRAM，把内部 RAM 留给 WiFi/LWIP 这类必须放内部的用途。
CONFIG_SPIRAM_MALLOC_ALWAYSINTERNAL=4096
CONFIG_SPIRAM_TRY_ALLOCATE_WIFI_LWIP=y
CONFIG_SPIRAM_IGNORE_NOTFOUND=y

# ---- OTA ----
# 开启回滚：新固件启动后必须显式确认，否则下次重启自动退回旧版本。
CONFIG_BOOTLOADER_APP_ROLLBACK_ENABLE=y
CONFIG_BOOTLOADER_APP_ANTI_ROLLBACK=n

# ---- Coredump ----
# 分区表里划了 coredump 分区，不开这项等于白留 64KB。
# ELF 格式与 SHA256 校验由 ESP_COREDUMP_ENABLE 自动选上，不需要也不能单独配置。
# CAPTURE_DRAM 保持关闭：打开后需要至少 128KB 的分区，而任务栈与寄存器现场
# 已经足够定位绝大多数崩溃。
CONFIG_ESP_COREDUMP_ENABLE_TO_FLASH=y
CONFIG_ESP_COREDUMP_CAPTURE_DRAM=n
CONFIG_ESP_COREDUMP_CHECK_BOOT=y

# ---- 编译 ----
# 固件按体积优化，给 OTA 双分区留出余量。
CONFIG_COMPILER_OPTIMIZATION_SIZE=y
CONFIG_COMPILER_OPTIMIZATION_ASSERTIONS_SILENT=y
CONFIG_COMPILER_STACK_CHECK_MODE_NORM=y

# ---- 日志 ----
CONFIG_LOG_DEFAULT_LEVEL_INFO=y
CONFIG_LOG_MAXIMUM_LEVEL_DEBUG=y
CONFIG_LOG_COLORS=y

# ---- FreeRTOS ----
# uxTaskGetSystemState() 需要它，用来采集所有任务的栈水位并通过接口暴露。
CONFIG_FREERTOS_USE_TRACE_FACILITY=y
CONFIG_FREERTOS_USE_STATS_FORMATTING_FUNCTIONS=y

# ---- 看门狗 ----
# 10 秒：OTA 写 flash 与 WiFi 扫描都可能让某个任务长时间不让出。
CONFIG_ESP_TASK_WDT_INIT=y
CONFIG_ESP_TASK_WDT_TIMEOUT_S=10
CONFIG_ESP_TASK_WDT_PANIC=y
CONFIG_ESP_INT_WDT=y

# ---- HTTP 服务 ----
CONFIG_HTTPD_MAX_REQ_HDR_LEN=1024
CONFIG_HTTPD_MAX_URI_LEN=512
CONFIG_HTTPD_ERR_RESP_NO_DELAY=y

# ---- LittleFS ----
CONFIG_LITTLEFS_MAX_PARTITIONS=3
CONFIG_LITTLEFS_USE_MTIME=y
CONFIG_LITTLEFS_MTIME_USE_SECONDS=y

# ---- 网络 ----
CONFIG_LWIP_LOCAL_HOSTNAME="kenko32"
CONFIG_ESP_WIFI_SOFTAP_SUPPORT=y
CONFIG_LWIP_DHCPS=y

# ---- 时间 ----
CONFIG_LWIP_SNTP_MAX_SERVERS=2
CONFIG_LWIP_SNTP_UPDATE_DELAY=3600000
```

## tools/ws2812-smoke-test/sdkconfig.defaults
```kconfig
CONFIG_IDF_TARGET="esp32s3"
CONFIG_PARTITION_TABLE_SINGLE_APP=y
CONFIG_PARTITION_TABLE_OFFSET=0x8000
CONFIG_ESPTOOLPY_FLASHSIZE_16MB=y
CONFIG_ESPTOOLPY_FLASHSIZE="16MB"
CONFIG_ESPTOOLPY_FLASHFREQ_80M=y
CONFIG_ESPTOOLPY_FLASHFREQ="80m"
CONFIG_ESPTOOLPY_FLASHMODE_DIO=y
CONFIG_ESPTOOLPY_FLASHMODE="dio"
CONFIG_ESP_CONSOLE_NONE=y
CONFIG_ESP_SYSTEM_PANIC_PRINT_REBOOT=y
CONFIG_FREERTOS_HZ=1000
```
